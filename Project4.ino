#define joystick_x  A0 // Joystick pin of x movement ( Up and Down )

const int dpin2 = 2; // Button pin
const int red = 9; // led
const int yellow =  11; // led
const int green = 13; // led

int  freq;
int type;

volatile int counter = 0;
int i = 0;
const int maxSamplesNum = 120;
const int maxWaveform = 3;

const int maxim = 50; // max speed
const int minim = 10 ; // max speed

static int Signal[maxWaveform][maxSamplesNum] = {
  // Sin wave
  {
    0x7ff, 0x86a, 0x8d5, 0x93f, 0x9a9, 0xa11, 0xa78, 0xadd, 0xb40, 0xba1,
    0xbff, 0xc5a, 0xcb2, 0xd08, 0xd59, 0xda7, 0xdf1, 0xe36, 0xe77, 0xeb4,
    0xeec, 0xf1f, 0xf4d, 0xf77, 0xf9a, 0xfb9, 0xfd2, 0xfe5, 0xff3, 0xffc,
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    0x3ff, 0x45d, 0x4be, 0x521, 0x586, 0x5ed, 0x655, 0x6bf, 0x729, 0x794
  }
  ,

  
  // Triangular wave
  {
    0x44, 0x88, 0xcc, 0x110, 0x154, 0x198, 0x1dc, 0x220, 0x264, 0x2a8,
    0x2ec, 0x330, 0x374, 0x3b8, 0x3fc, 0x440, 0x484, 0x4c8, 0x50c, 0x550,
    0x594, 0x5d8, 0x61c, 0x660, 0x6a4, 0x6e8, 0x72c, 0x770, 0x7b4, 0x7f8,
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    0x264, 0x220, 0x1dc, 0x198, 0x154, 0x110, 0xcc, 0x88, 0x44, 0x0
  }
  ,

  // Square wave
  {
    0xfff, 0xfff, 0xfff, 0xfff, 0xfff, 0xfff, 0xfff, 0xfff, 0xfff, 0xfff,
    0xfff, 0xfff, 0xfff, 0xfff, 0xfff, 0xfff, 0xfff, 0xfff, 0xfff, 0xfff,
    0xfff, 0xfff, 0xfff, 0xfff, 0xfff, 0xfff, 0xfff, 0xfff, 0xfff, 0xfff,
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    0x0, 0x0, 0x0, 0x0, 0x0, 0x0, 0x0, 0x0, 0x0, 0x0
  }

};

  
void setup() {
  // put your setup code here, to run once:
  Serial.begin(9600*2);
  attachInterrupt(digitalPinToInterrupt(dpin2), WaveGenerator, RISING); 
  pinMode(red,OUTPUT);
  pinMode(yellow,OUTPUT);
  pinMode(green,OUTPUT);
}

void loop() {
  // put your main code here, to run repeatedly:
  Frequency();
  for (i = 0; i < maxSamplesNum; i++){
    Serial.println(Signal[type][i]); 
    delay(freq);

  }
  
}

void Frequency(){
  int value_j = analogRead(joystick_x); 

  if(  (value_j >= 200) && (value_j <= 800) ) {
    freq = 30;
    }
    
  if(  (value_j >= 0) && (value_j < 200) ) {
  freq = freq + 10;
  
  if (freq >= 50){  // Speed limit
    freq = maxim;
  }
  delay(freq);
  }
  
  if(  (value_j > 800) && (value_j <= 1023) ) {
  freq = freq - 10;
  if (freq <= 10){      // Speed limit
    freq = minim;
  }
  delay(freq);
  } 
}

void Sinuswave(){
  type = 0;
}

void Squarewave(){
  type = 2;
}

void Trianghwave(){
  type = 1;
}

void WaveGenerator(){
  
  counter = counter + 1;
  if (counter == 4){
    counter = 1;
  }
  if (counter == 1){
    Sinuswave();
    digitalWrite(red,HIGH);
    digitalWrite(yellow,LOW);
    digitalWrite(green,LOW);
  }
  if (counter == 2){
    Squarewave();
    digitalWrite(yellow,HIGH);
    digitalWrite(red,LOW);
    digitalWrite(green,LOW);
  }
  if (counter == 3){
    Trianghwave();
    digitalWrite(green,HIGH);
    digitalWrite(red,LOW);
    digitalWrite(yellow,LOW);
  }

}
